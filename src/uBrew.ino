/*  uBrew - Temperature controller
  Copyright (c) 2018 Leonardo Bispo.  All right reserved.
Permission is hereby granted, free of charge, to any person obtaining a copy
of this software and associated documentation files (the "Software"), to deal
in the Software without restriction, including without limitation the rights
to use, copy, modify, merge, publish, distribute, sublicense, and/or sell
copies of the Software, and to permit persons to whom the Software is
furnished to do so, subject to the following conditions:
The above copyright notice and this permission notice shall be included in all
copies or substantial portions of the Software.
THE SOFTWARE IS PROVIDED "AS IS", WITHOUT WARRANTY OF ANY KIND, EXPRESS OR
IMPLIED, INCLUDING BUT NOT LIMITED TO THE WARRANTIES OF MERCHANTABILITY,
FITNESS FOR A PARTICULAR PURPOSE AND NONINFRINGEMENT. IN NO EVENT SHALL THE
AUTHORS OR COPYRIGHT HOLDERS BE LIABLE FOR ANY CLAIM, DAMAGES OR OTHER
LIABILITY, WHETHER IN AN ACTION OF CONTRACT, TORT OR OTHERWISE, ARISING FROM,
OUT OF OR IN CONNECTION WITH THE SOFTWARE OR THE USE OR OTHER DEALINGS IN THE
SOFTWARE. */

#define BLYNK_PRINT Serial

#include <blynk.h>

#include "Adafruit_GFX.h"
#include "Adafruit_SSD1306.h"
#include "pid.h"
//#include "Particle-OneWire.h"
#include "DS18B20.h"

double Setpoint, Input, Output;
double aggKp=2, aggKi=10, aggKd=0.25;
//double consKp=1, consKi=0.05, consKd=0.25;
double consKp=2, consKi=5, consKd=1;
PID myPID(&Input, &Output, &Setpoint, consKp, consKi, consKd, PID::DIRECT);

#define OLED_RESET D4
Adafruit_SSD1306 display(OLED_RESET);
DS18B20 ds18b20 = DS18B20(A0, true);     // 1-wire signal on pin A0
BlynkTimer timer;

int DS18B20nextSampleTime = 2000;
int DS18B20_SAMPLE_INTERVAL = 2000;
int DS18B20_MAXRETRY =4;
float tempHive;
int element = D3;       //element PWM
int xaxis = A5;         //X axis buttom
int yaxis = A4;         //Y axis buttom
int swb = A3;           //Press buttom
int pump = D5;          //Pump
float celsius;          //Mash temp
float t1;
float t2;
float zeromillis=0;       //zero millis for boil time calculate
float lastpumpoff=0;         //pump cycle
int fermentationtime = 0; //fermentation notification;
unsigned long ti=0;       //calculate seconds left
int h = 0;                //calculate minutes left
int t = 0;
int notification = 0; //secure to notify just once
int Tmash=69;       //Mash cooking Temp
int end;            //end of the menu
int X;                //X axis
int Y;                //Y axis
int SW;               //Middle buttom pressed
int tree=0;           //menu tree
int sparge=15;        //sparge time
int mashTimer=60;            //Mash time in minutes
int tboil = 60;         //Boil timer
int boiltemp=98;     //boil temperature
int hopadd=2;          //Hop addition
int first=60;
int second=15;        //Hop addition timer to the end in minutes
bool conf=false;      //exit menu
int mashtime=1;  //finish of mashtime
int boiltime=0;  //finish of boil time
int aftertemp=0;  //timer after temp reach desired level
double sliderV3=0;
int sliderV7=0;
int timeon=40000;   //Pump on time in millisec
int pumpauto;     //HIGH = Auto and LOW = MANUAL
int pumpbutton;   //Manual control over the pump

char auth[] = "b4706060e3da4f918ebb75e3277ecb3c";
BLYNK_WRITE(V3)
{
  sliderV3 = param.asDouble(); // assigning incoming value from pin V3 to a variable
  sliderV7 = param.asInt(); // assigning incoming value from pin V7 to a variable
}
BLYNK_WRITE(V7)
{
  sliderV7 = param.asInt(); // assigning incoming value from pin V7 to a variable
}
BLYNK_WRITE(V5)
{
  pumpauto = param.asInt(); // assigning incoming value from pin V7 to a variable
}
BLYNK_WRITE(V6)
{
  pumpbutton = param.asInt(); // assigning incoming value from pin V7 to a variable
}

static const unsigned char beer[] = {
  0xff, 0xff, 0xff, 0xff, 0xff, 0xff, 0xff, 0xff, 0xff, 0xff, 0xff, 0xff, 0xff, 0xff, 0xff, 0xff,
  0xff, 0xff, 0xff, 0xff, 0xff, 0xff, 0xff, 0xff, 0xff, 0xff, 0xff, 0xff, 0xff, 0xff, 0xff, 0xff,
  0xff, 0xff, 0xff, 0xff, 0xff, 0xff, 0xff, 0xff, 0xff, 0xe0, 0x7f, 0xff, 0xff, 0xff, 0xff, 0xff,
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  0xff, 0xff, 0xff, 0xcb, 0x07, 0x00, 0x01, 0x7f, 0xff, 0xff, 0xff, 0xff, 0xff, 0xff, 0xff, 0xff,
};

static const unsigned char alarm[] = {
  0xff, 0xff, 0xff, 0xff, 0xff, 0xff, 0xff, 0xff, 0xff, 0xff, 0xff, 0xff, 0xff, 0xff, 0xff, 0xff,
  0xff, 0xff, 0xff, 0xff, 0xff, 0xff, 0xff, 0xff, 0xff, 0xff, 0xff, 0xff, 0xff, 0xff, 0xff, 0xff,
  0xff, 0xff, 0xff, 0xff, 0xff, 0x3f, 0xff, 0xff, 0xff, 0xff, 0xff, 0xff, 0xff, 0xff, 0xff, 0xff,
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  0xff, 0xff, 0xff, 0xff, 0xff, 0xff, 0xff, 0xff, 0xff, 0xff, 0xff, 0xff, 0xff, 0xff, 0xff, 0xff,
};

static const unsigned char heart[] = {
  0x00, 0x00, 0x00, 0x00, 0x00, 0x00, 0x00, 0x00, 0x00, 0x00, 0x00, 0x00, 0x00, 0x00, 0x00, 0x00,
  0x00, 0x00, 0x00, 0x00, 0x00, 0x00, 0x00, 0x00, 0x00, 0x00, 0x00, 0x00, 0x00, 0x00, 0x00, 0x00,
  0x00, 0x00, 0x00, 0x00, 0x00, 0x07, 0xff, 0x00, 0x00, 0x03, 0xff, 0x80, 0x00, 0x00, 0x00, 0x00,
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  0x00, 0x00, 0x00, 0x00, 0x00, 0x00, 0x00, 0x00, 0x30, 0x00, 0x00, 0x00, 0x00, 0x00, 0x00, 0x00,
};

void setup()
{
  Serial.begin(9600);
  display.begin(SSD1306_SWITCHCAPVCC, 0x3C);  // initialize with the I2C addr 0x3D (for the 128x64)
  myPID.SetMode(PID::AUTOMATIC);

  Blynk.begin(auth);
  display.clearDisplay();        // clears the screen and buffer
  pinMode(xaxis, INPUT);         //X axis buttom
  pinMode(yaxis, INPUT);         //Y axis buttom
  pinMode(swb, INPUT);           //Press buttom
  pinMode(element, OUTPUT);      //Element PWM
  pinMode(pump, OUTPUT);         //Pump
  digitalWrite(pump, HIGH);      //Pump activated in LOW
  pinMode(TX, OUTPUT);           //Temp sensor power supply
  digitalWrite(TX, HIGH);        //Temp sensor power supply
}


void loop() {
  Blynk.run();

  //stay in config menu until choose config
  while (end<1)    startmenu();

  if (millis() > DS18B20nextSampleTime)
  {
    GetTemp();
    Blynk.virtualWrite(V1, celsius);
  }

  if (mashtime==1)
  {
    Setpoint=Tmash;
    PIDcontrol();

    display.clearDisplay();
    display.setTextSize(2);
    display.setTextColor(WHITE);
    display.setCursor(0,0);
    display.print("Mash "); display.print(h); display.print(":"); display.print(ti);
    display.setCursor(0,16);
    display.print("Target "); display.print(Tmash); display.print("C");
    display.setCursor(00,34);
    display.setTextSize(3);
    display.print("T="); display.print(celsius,1); display.print("C");
    display.display();

    if(celsius>=Tmash)
    {
      aftertemp++;
      if (aftertemp<=1)
      {
        digitalWrite(pump, LOW);      //Turn Pump ON
        lastpumpoff = millis();
        zeromillis = millis();
      }
    }

    if (aftertemp>=1)
    {
      //ALARM DISPLAY AND NOTIFICATION SETTINGS
      if (celsius < (Tmash-3) || celsius > (Tmash+3))
      {
        t1 = (millis()-t1)/1000;
        t2 = t2+t1;
        if  (notification<1 && t2>20)
        {                    //NOTIFY ONCE AFTER 20SEC
          Blynk.notify("We have a problem!");
          notification++;
          t2=0;
        }
        if (t2>20)
        {                                     //SCREEN ALARM EVERY 20SEC
          display.clearDisplay();
          display.drawBitmap(0, 0, alarm, 128, 64, 1);
          display.display();
          delay (1000);
          t2=0;
        }
      }
      else
      {
        t1=0;
        t2=0;
        notification = 0;
      }
    // splash screen beer/heart
      if (t==8)
      {
        display.clearDisplay();
        display.drawBitmap(0, 0,  heart, 128, 64, 1);
        display.display();
        delay(1000);
        display.clearDisplay();
        display.drawBitmap(0, 0,  beer, 128, 64, 1);
        display.display();
        delay(1000);
        t=0;
      }

      t++;
      t1 = millis();
      h=(mashTimer*60*1000-(millis()-zeromillis))/60000;   //calculate minutes left
      ti=(mashTimer*60*1000-(millis()-zeromillis)-h*60000)/1000;   //calculate seconds left
      Blynk.virtualWrite(V0,h);

      if (pumpauto==1)
      {
        if (sliderV7!=0) timeon=sliderV7*1000;
        if (millis()-lastpumpoff<timeon)  digitalWrite(pump, LOW);                //turn pump On
        if (millis()-lastpumpoff>timeon)
        {           //120 second On
          digitalWrite(pump, HIGH);              //turn pump Off
          if (millis()-lastpumpoff>(timeon+60000))
          {       //60 seconds Off
            lastpumpoff=millis();
          }
        }
      }
      if (pumpauto==0) digitalWrite(pump, pumpbutton);
    }
    else h=mashTimer;
    if (h==0 && ti==0)
    {
      boiltime++;
      mashtime--;
      aftertemp=0;
      h=tboil;
      digitalWrite(pump, HIGH);                //turn pump Off
      Blynk.notify("SPARGE TIME");
      tree=0;
    }
}

    if (boiltime==1){

      SW = digitalRead(swb);
      if (SW==LOW) tree++;
      if (tree==0){
      analogWrite(element,0,50);
      display.clearDisplay();
      display.setTextSize(2);
      display.setCursor(0,0);
      display.print("Is sparge over?");
      display.setCursor(36,36);
      display.setTextColor(BLACK, WHITE); display.print("YES");
      display.display();
      PIDcontrol();
      }
      if (tree>=1){
      Setpoint=boiltemp;
      PIDcontrol();
        display.clearDisplay();
        display.setCursor(0,0);
        display.setTextColor(WHITE);
        display.setTextSize(2);
        display.print("BOIL "); display.print(h); display.print(":"); display.print(ti);
        display.setCursor(0,16);
        display.print("Target "); display.print(boiltemp); display.print("C");
        display.setCursor(00,34);
        display.setTextSize(3);
        display.print("T="); display.print(celsius,1); display.print("C");
        display.display();

      if(celsius>=boiltemp) {
        aftertemp++;
        if (aftertemp<=1){
        zeromillis = millis();  }
      }
      if (aftertemp>=1){
      //ALARM DISPLAY AND NOTIFICATION SEETINGS
      if (celsius < (boiltemp-5) || celsius > (boiltemp+5)){
        t1 = (millis()-t1)/1000;
        t2 = t2+t1;
        if  (notification<1 && t2>20){                    //NOTIFY ONCE AFTER 20SEC
          Blynk.notify("AZEDOU");
          notification++;
          t2=0;
        }
        if (t2>20){                                     //SCREEN ALARM EVERY 20SEC
          display.clearDisplay();
          display.drawBitmap(0, 0, alarm, 128, 64, 1);
          display.display();
          delay (1000);
          t2=0;
        }
      }
      else{
        t1=0;
        t2=0;
        notification = 0;
      }
      // splash screen beer/heart
      if (t==10){
        display.clearDisplay();
        display.drawBitmap(0, 0,  heart, 128, 64, 1);
        display.display();
        delay(1000);
        display.clearDisplay();
        display.drawBitmap(0, 0,  beer, 128, 64, 1);
        display.display();
        delay(1000);
        t=0;
      }
    t++;
    t1 = millis();

    h=(tboil*60*1000-(millis()-zeromillis))/60000;   //calculate minutes left
    ti=(tboil*60*1000-(millis()-zeromillis)-h*60000)/1000;   //calculate seconds left
    Blynk.virtualWrite(V0,h);
    if (h==second && ti==0) Blynk.notify("ADD 2nd HOP");
    }
    if (h==0 && ti==0) {
      boiltime++;
      mashtime--;
    }
    // splash screen beer/heart
    if (t==8){
      display.clearDisplay();
      display.drawBitmap(0, 0,  heart, 128, 64, 1);
      display.display();
      delay(1000);
      display.clearDisplay();
      display.drawBitmap(0, 0,  beer, 128, 64, 1);
      display.display();
      delay(1000);
      t=0;
    }
  }
  }

  if (boiltime==2 && mashtime==-1) {
    analogWrite(element,0,50);
    if (fermentationtime<1){
    Blynk.notify("FERMENTATION TIME");
    fermentationtime++;    }
    display.clearDisplay();
    display.setCursor(00,10);
    display.setTextSize(3);
    display.println("TO THE");display.println("Fermenter");
    end=0;
    mashTimer=60;
    Tmash=69;
    display.display();
  }
}

void GetTemp()
{
    int i = 0;
    do {
    celsius = ds18b20.getTemperature();
    } while (!ds18b20.crcCheck() && DS18B20_MAXRETRY > i++);
    tempHive = (i < DS18B20_MAXRETRY) ? celsius : 99.9;
}

void PIDcontrol(){
  Input = celsius;
  //myPID.Compute();
  double gap = abs(Setpoint-Input); //distance away from setpoint
  if(gap<2)
  {  //we're close to setpoint, use conservative tuning parameters
    myPID.SetTunings(consKp, consKi, consKd);
  }
  else
  {
    //we're far from setpoint, use aggressive tuning parameters
    myPID.SetTunings(aggKp, aggKi, aggKd);
  }
  myPID.Compute();
  if (sliderV3!=0) Output = sliderV3/255;
  Blynk.virtualWrite(V2, Output);
  Output=Output*0.63;                 //Limit Element to 10A = 2400Watts!!!!! The element is 3,500W
  analogWrite(element,Output,50);     //Output PIN to be set up
}

void startmenu()
{
  display.clearDisplay();
  display.setTextSize(2);
  display.setTextColor(WHITE);
  display.setCursor(0,0);
  X = analogRead(xaxis);
  Y = analogRead(yaxis);
  SW = digitalRead(swb);
  if(conf==false){
    if (SW==LOW) tree++;
    delay(50);
  }
  if (tree>8) tree=0;
  if (tree==0){
    display.print(">Temp: "); display.setTextColor(BLACK, WHITE);display.print(Tmash); display.setTextColor(WHITE); display.setTextSize(1);display.print("C");
    if(X>4000) Tmash++;
    if(X<100) Tmash--;
    display.setTextSize(2);
    display.setCursor(0,16);
    display.print(" Timer:"); display.print(mashTimer); display.setTextSize(1);display.print("Min");
    display.setTextSize(2);
    display.setCursor(0,32);
    display.print(" Sparge"); display.print(sparge); display.setTextSize(1);display.print("Min");
    display.setTextSize(2);
    display.setCursor(0,48);
    display.print(" Boil: "); display.print(tboil);display.setTextSize(1);display.print("Min");
    display.display();
  }
  if (tree==1){
    display.print(" Temp: "); display.print(Tmash); display.setTextSize(1);display.print("C");
    if(X>4000) mashTimer++;
    if(X<100) mashTimer--;
    display.setTextSize(2);
    display.setCursor(0,16);
    display.print(">Timer:"); display.setTextColor(BLACK, WHITE);display.print(mashTimer); display.setTextColor(WHITE);display.setTextSize(1);display.print("Min");
    display.setTextSize(2);
    display.setCursor(0,32);
    display.print(" Sparge"); display.print(sparge); display.setTextSize(1);display.println("Min");
    display.setTextSize(2);
    display.setCursor(0,48);
    display.print(" Boil: "); display.print(tboil);display.setTextSize(1);display.println("Min");
    display.display();
  }
  if (tree==2){
    display.print(" Temp: "); display.print(Tmash); display.setTextColor(WHITE); display.setTextSize(1);display.print("C");
    if(X>4000) sparge++;
    if(X<100) sparge--;
    display.setTextSize(2);
    display.setCursor(0,16);
    display.print(" Timer:"); display.print(mashTimer); display.setTextSize(1);display.print("Min");
    display.setTextSize(2);
    display.setCursor(0,32);
    display.print(">Sparge"); display.setTextColor(BLACK, WHITE);display.print(sparge); display.setTextColor(WHITE);display.setTextSize(1);display.println("Min");
    display.setTextSize(2);
    display.setCursor(0,48);
    display.print(" Boil: "); display.print(tboil);display.setTextSize(1);display.println("Min");
    display.display();
  }
  if (tree==3){
    display.print(" Temp: "); display.print(Tmash); display.setTextColor(WHITE); display.setTextSize(1);display.print("C");
    if(X>4000) tboil++;
    if(X<100) tboil--;
    first = tboil;
    display.setTextSize(2);
    display.setCursor(0,16);
    display.print(" Timer:"); display.print(mashTimer); display.setTextSize(1);display.print("Min");
    display.setTextSize(2);
    display.setCursor(0,32);
    display.print(" Sparge"); display.print(sparge); display.setTextSize(1);display.println("Min");
    display.setTextSize(2);
    display.setCursor(0,48);
    display.print(">Boil: "); display.setTextColor(BLACK, WHITE);display.print(tboil); display.setTextColor(WHITE);display.setTextSize(1);display.println("Min");
    display.display();
  }
  if (tree==4){
    display.print("Hop add:"); display.setTextColor(BLACK, WHITE); display.print(hopadd); display.setTextColor(WHITE); display.print("X");
    if(X>4000) hopadd++;
    if(X<100) hopadd--;
    display.display();
}
  if (tree==5){
  if(hopadd==1){
      display.print("Hop add:"); display.print(hopadd); display.print("X");
      if(X>4000) first++;
      if(X<100) first--;
      display.setTextSize(2);
      display.setCursor(0,16);
      display.print("1st add"); display.setTextColor(BLACK, WHITE);display.print(first); display.setTextColor(WHITE);display.setTextSize(1);display.print("Min");
      display.display();
    }
  if(hopadd==2){
      display.print("Hop add:"); display.print(hopadd); display.print("X");
      if(X>4000) first++;
      if(X<100) first--;
      display.setTextSize(2);
      display.setCursor(0,16);
      display.print("1st add"); display.setTextColor(BLACK, WHITE);display.print(first); display.setTextColor(WHITE);display.setTextSize(1);display.print("Min");
      display.setTextSize(2);
      display.setCursor(0,32);
      display.print("2nd add"); display.print(second); display.setTextSize(1);display.print("Min");
      display.display();
    }
  }
  if (tree==6 && hopadd==2){
    display.print("Hop add:"); display.print(hopadd); display.print("X");
    if(X>4000) second++;
    if(X<100) second--;
    display.setTextSize(2);
    display.setCursor(0,16);
    display.print("1st add"); display.print(first); display.setTextSize(1);display.print("Min");
    display.setTextSize(2);
    display.setCursor(0,32);
    display.print("2nd add"); display.setTextColor(BLACK, WHITE);display.print(second); display.setTextColor(WHITE);display.setTextSize(1);display.print("Min");
    display.display();
  }
  if (tree==6 && (hopadd>2 || hopadd<1)) {
    display.print("Hop add   only 1 or 2 allowed!");
    display.display();
    delay(2000);
    tree=4;
  }
  if (tree==6 && hopadd==1)tree=7;
  if (tree==7){
    if(Y>4000) conf=true;
    if(Y<100) conf=false;
    if(conf==false){
      display.print("BEER Time?");
      display.setTextSize(3);
      display.setCursor(12,32);
      display.setTextColor(BLACK, WHITE);display.print("NO"); display.setTextColor(WHITE);display.print(" ");display.print("YES");
      display.display();
    }
    if(conf==true){
        display.clearDisplay();
        display.setTextSize(2);
        display.setTextColor(WHITE);
        display.setCursor(0,0);
        display.print("BEER Time?");
        display.setTextSize(3);
        display.setCursor(12,32);
        display.print("NO"); display.print(" ");display.setTextColor(BLACK, WHITE);display.print("YES");
        display.display();
        if (SW==LOW) end++;
      }
  }
  Particle.process();
}
